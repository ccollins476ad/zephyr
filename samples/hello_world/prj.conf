## CMakeLists.txt
```
# Top-level CMakeLists.txt for the skeleton application.
#
# Copyright (c) 2017 Open Source Foundries Limited
#
# SPDX-License-Identifier: Apache-2.0
#
# This provides a basic application structure suitable for loading by
# mcuboot, which is easy to customize on a per-board basis. It can be
# used as a starting point for new applications.

# The board should be set to a supported target. The default is
# frdm_k64f.
#if (NOT DEFINED BOARD)
  #set(BOARD frdm_k64f)
#endif()

# The default top-level application configuration is prj.conf.
# You can place additional board-specific files in boards/${BOARD}.conf,
# and they will be merged into the configuration along with prj.conf.
macro(set_conf_file)
  if(EXISTS ${APPLICATION_SOURCE_DIR}/boards/${BOARD}.conf)
    set(CONF_FILE "prj.conf ${APPLICATION_SOURCE_DIR}/boards/${BOARD}.conf")
  else()
    set(CONF_FILE "prj.conf")
  endif()
endmacro()

# Zephyr uses Device Tree (DT) to describe some board hardware
# configuration.
#
# For this simple example, all we need to tell DT is where on the chip
# flash to link this application image so mcuboot can find it. We do
# this with a device tree overlay file.
#
# See the Zephyr documentation for more information on DT:
# http://docs.zephyrproject.org/devices/dts/device_tree.html
set(DTC_OVERLAY_FILE "${CMAKE_CURRENT_SOURCE_DIR}/dts.overlay")

# Standard Zephyr application boilerplate.
include($ENV{ZEPHYR_BASE}/cmake/app/boilerplate.cmake NO_POLICY_SCOPE)
project(NONE)

assert_exists(DTC_OVERLAY_FILE)

# This string ends up getting printed in the device console
if (NOT DEFINED FROM_WHO)
  set(FROM_WHO Zephyr)
endif()

target_sources(app PRIVATE
    src/cborattr/src/cborattr.c
    src/main.c
    src/mcumgr/cmd/img_mgmt/port/zephyr/src/zephyr_img_mgmt.c
    src/mcumgr/cmd/img_mgmt/src/img_mgmt.c
    src/mcumgr/cmd/img_mgmt/src/img_mgmt_state.c
    src/mcumgr/cmd/img_mgmt/src/img_mgmt_util.c
    src/mcumgr/cmd/os_mgmt/src/os_mgmt.c
    src/mcumgr/cmd/os_mgmt/port/zephyr/src/zephyr_os_mgmt.c
    src/mcumgr/mgmt/src/mgmt.c
    src/mcumgr/smp/port/zephyr/src/zephyr_smp.c
    src/mcumgr/smp/src/smp.c
    src/tinycbor/src/cbor_buf_reader.c
    src/tinycbor/src/cbor_buf_writer.c
    src/tinycbor/src/cborencoder.c
    src/tinycbor/src/cborerrorstrings.c
    src/tinycbor/src/cborparser.c
    src/tinycbor/src/cborparser_dup_string.c
    #src/tinycbor/src/cborpretty.c
    #src/tinycbor/src/cbortojson.c
    #src/tinycbor/src/cborvalidation.c
    src/znp/src/znp.c

)

target_include_directories(app PRIVATE
    src/cborattr/include
    src/mcuboot/boot/bootutil/include
    src/mcuboot/boot/bootutil/src
    src/mcuboot/boot/zephyr/include
    src/mcumgr/cmd/img_mgmt/include
    src/mcumgr/cmd/os_mgmt/include
    src/mcumgr/mgmt/include
    src/mcumgr/smp/include
    src/mcumgr/smp/port/zephyr/include
    src/tinycbor/src
    src/znp/include
)
```

## prj.conf
```kconfig
CONFIG_BT=y
CONFIG_BT_L2CAP_RX_MTU=256
CONFIG_BT_L2CAP_TX_BUF_COUNT=8
CONFIG_BT_L2CAP_TX_MTU=256
CONFIG_BT_PERIPHERAL=y
CONFIG_BT_RX_BUF_LEN=260
CONFIG_DEBUG=y
CONFIG_FLASH=y
CONFIG_HEAP_MEM_POOL_SIZE=16384
CONFIG_IMG_MANAGER=y
CONFIG_MCUBOOT_IMG_MANAGER=y
CONFIG_MPU_ALLOW_FLASH_WRITE=y
CONFIG_NEWLIB_LIBC=y
CONFIG_REBOOT=y
CONFIG_SYSTEM_WORKQUEUE_STACK_SIZE=2048
CONFIG_TEXT_SECTION_OFFSET=0x200
CONFIG_THREAD_MONITOR=y
CONFIG_UART_MCUMGR=y
CONFIG_UART_MCUMGR_ON_DEV_NAME="UART_0"

#CONFIG_KERNEL_DEBUG=y
```

## dts.overlay
```dts
/*
 * Basic Device Tree overlay file for chain-loading by mcuboot.
 * See the Makefile for more information.
 */

/ {
	chosen {
		zephyr,code-partition = &slot0_partition;
        zephyr,uart-mcumgr = &uart0;
	};
};
```

## src/main.c
```c
/*
 * Copyright (c) 2012-2014 Wind River Systems, Inc.
 *
 * SPDX-License-Identifier: Apache-2.0
 */

#include <assert.h>
#include <zephyr.h>
#include <string.h>
#include <stdlib.h>
#include <bluetooth/bluetooth.h>
#include <bluetooth/conn.h>
#include <bluetooth/gatt.h>
#include "console/uart_mcumgr.h"
#include "os_mgmt/os_mgmt.h"
#include "img_mgmt/img_mgmt.h"
#include "mgmt/smp_bt.h"
#include "zephyr_smp/zephyr_smp.h"
#include "znp/znp.h"
 
K_FIFO_DEFINE(fifo_reqs);

static struct zephyr_smp_transport uart_zst;
static struct zephyr_smp_transport bt_zst;

static int num_alloced;

#define DEVICE_NAME         CONFIG_BT_DEVICE_NAME
#define DEVICE_NAME_LEN     (sizeof(DEVICE_NAME) - 1)

static const struct bt_data ad[] = {
    BT_DATA_BYTES(BT_DATA_FLAGS, (BT_LE_AD_GENERAL | BT_LE_AD_NO_BREDR)),
    BT_DATA_BYTES(BT_DATA_UUID16_ALL, 0x0d, 0x18, 0x0f, 0x18, 0x05, 0x18),
};

static const struct bt_data sd[] = {
    BT_DATA(BT_DATA_NAME_COMPLETE, DEVICE_NAME, DEVICE_NAME_LEN),
};

static struct zephyr_nmgr_pkt *
alloc_pkt(void)
{
    struct zephyr_nmgr_pkt *pkt;

    pkt = k_malloc(sizeof *pkt);
    assert(pkt != NULL);
    pkt->len = 0;

    num_alloced++;
    return pkt;
}

static struct bt_conn *
conn_from_pkt(const struct zephyr_nmgr_pkt *pkt)
{
    bt_addr_le_t addr;

    memcpy(&addr, pkt->extra, sizeof addr);
    return bt_conn_lookup_addr_le(&addr);
}

static int
tx_pkt_uart(struct zephyr_smp_transport *zst, struct zephyr_nmgr_pkt *pkt)
{
    int rc;

    rc = uart_mcumgr_send(pkt->data, pkt->len);
    k_free(pkt);

    return rc;
}

static int
tx_pkt_bt(struct zephyr_smp_transport *zst, struct zephyr_nmgr_pkt *pkt)
{
    struct bt_conn *conn;
    int rc;

    conn = conn_from_pkt(pkt);
    if (conn == NULL) {
        rc = -1;
    } else {
        rc = smp_bt_tx_rsp(conn, pkt->data, pkt->len);
        bt_conn_unref(conn);
    }

    k_free(pkt);

    return rc;
}

static uint16_t
get_mtu_bt(const struct zephyr_nmgr_pkt *pkt)
{
    struct bt_conn *conn;
    uint16_t mtu;

    conn = conn_from_pkt(pkt);
    if (conn == NULL) {
        return 0;
    }

    mtu = bt_gatt_get_mtu(conn);
    bt_conn_unref(conn);

    /* 3 is the number of bytes for ATT notification base */
    return mtu - 3;
}

static void
recv_cb(const uint8_t *buf, size_t len)
{
    struct zephyr_nmgr_pkt *pkt;

    pkt = alloc_pkt();
    memcpy(pkt->data, buf, len);
    pkt->len = len;

    zephyr_smp_rx_req(&uart_zst, pkt);
}

static void
bt_recv_cb(struct bt_conn *conn, const u8_t *buf, size_t len)
{
    struct zephyr_nmgr_pkt *pkt;
    const bt_addr_le_t *addr;

    pkt = alloc_pkt();
    memcpy(pkt->data, buf, len);
    pkt->len = len;

    addr = bt_conn_get_dst(conn);
    memcpy(pkt->extra, addr, sizeof *addr);

    zephyr_smp_rx_req(&bt_zst, pkt);
}

static void advertise(void)
{
    int rc;

    bt_le_adv_stop();

    rc = bt_le_adv_start(BT_LE_ADV_CONN, ad, ARRAY_SIZE(ad),
                  sd, ARRAY_SIZE(sd));
    if (rc) {
        printk("Advertising failed to start (rc %d)\n", rc);
        return;
    }

    printk("Advertising successfully started\n");
}

static void connected(struct bt_conn *conn, u8_t err)
{
    if (err) {
        printk("Connection failed (err %u)\n", err);
    } else {
        printk("Connected\n");
    }
}

static void disconnected(struct bt_conn *conn, u8_t reason)
{
    printk("Disconnected (reason %u)\n", reason);
    advertise();
}

static struct bt_conn_cb conn_callbacks = {
    .connected = connected,
    .disconnected = disconnected,
};

static void bt_ready(int err)
{
    if (err) {
        printk("Bluetooth init failed (err %d)\n", err);
        return;
    }

    printk("Bluetooth initialized\n");

    advertise();
}

void main(void)
{
    int rc;

    rc = os_mgmt_group_register();
    assert(rc == 0);

    rc = img_mgmt_group_register();
    assert(rc == 0);

    uart_mcumgr_register(recv_cb);

    zephyr_smp_transport_init(&bt_zst, tx_pkt_bt, get_mtu_bt);
    zephyr_smp_transport_init(&uart_zst, tx_pkt_uart, NULL);

    rc = bt_enable(bt_ready);
    if (rc != 0) {
        printk("Bluetooth init failed (err %d)\n", rc);
        return;
    }

    smp_bt_register(bt_recv_cb);

    bt_conn_cb_register(&conn_callbacks);

    k_sleep(INT32_MAX);
}
```
